## drivers/net/str8100/Kconfig
```kconfig
menu "CNS2100 NIC support"
	depends on ARCH_STR8100 && (NET_ETHERNET || NETDEV_1000)

config STAR_NIC
	tristate "CNS2100 NIC driver support"
	help

choice 
	depends on STAR_NIC 
        prompt "PHY Driver"
        default STR_NIC_PHY_VSC8201
          
config STAR_NIC_PHY_INTERNAL_PHY
        bool "Internal 10/100 PHY"

config STAR_NIC_PHY_VSC8601
        bool "Vitesse 8601"
        
config STAR_NIC_PHY_IP101A
        bool "ICPlus IP101A"

config STAR_NIC_PHY_IP1001
		bool "ICPlus IP1001"
          
endchoice

endmenu
```

## drivers/net/str9100.new/Kconfig
```kconfig
menu "STAR Gigabit Switch support"
	depends on ARCH_STR9100

config STAR_GSW
	tristate "STAR Gigabit Switch driver support"

config STR9100_SHNAT
	bool "STAR Smart HNAT Support"
	depends on STAR_GSW
	help
	  Add STAR Smart HNAT support function in kernel

config STAR9100_SHNAT_PCI_FASTPATH
	bool "FastPath(From PCI to WAN) Support"
	depends on STR9100_SHNAT
	help
	  Add FastPath Support for Smart HNAT.

choice
	prompt "STAR Board"
	depends on STAR_GSW
	default DORADO

config DORADO
	bool "Dorado"

config DORADO2
	bool "Dorado2"

config VIRGO
	bool "Virgo"

config VELA
	bool "Vela"

config LIBRA
	bool "Libra"

config LEO
	bool "Leo"

endchoice

endmenu
```
